#include "hal_data.h"
#include "menu.h"
#if (1 == BSP_MULTICORE_PROJECT) && BSP_TZ_SECURE_BUILD
bsp_ipc_semaphore_handle_t g_core_start_semaphore =
    {
        .semaphore_num = 0};
#endif
I2CDev *ptEepromDev;
void entry_init(void)
{
    circlebuf_init();                // 环形缓冲区初始化
    SystickInit();                   // 系统滴答时钟初始化
    printf_init();                   // printf初始化
    LCD_Init();                      // LCD初始化
    Init_All_Timers();               // 定时器相关初始化
    ADC_init();                      // ADC初始化
    Key_Init();                      // 按键初始化
    Lidar_Init();                    // 雷达初始化
    ptEepromDev = EEPROMGetDevice(); // 获取控制结构体
    ptEepromDev->Init(ptEepromDev);  // 初始化IIC
    // PID_coefficient_set(1.85,0.15,0.0055); // pid参数初始化
    Load_PID_From_EEPROM(); // 上电自动读取，如果没有则用默认值
    Load_Nav_PID_From_EEPROM();
    MechanicalHand_Init(); // 机械臂初始化
    VisionUart9_Init();    // 视觉通讯串口初始化
    RobotControl_Init();   // 控制协调层初始化
    timer_1ms_start();     // 开启1ms定时器
}

/*******************************************************************************************************************/ /**
                                                                                                                       * main() is generated by the RA Configuration editor and is used to generate threads if an RTOS is used.  This function
                                                                                                                       * is called by main() when no RTOS is used.
                                                                                                                       **********************************************************************************************************************/
void hal_entry(void)
{
    /* TODO: add your own code here */
    entry_init();          // 初始化
    g_state = MENU_MAIN;   // 界面初始值
    g_need_refresh = true; // 是否更新界面标志位
    key_event_t event;     // 按键状态存储
		g_nav_target_speed = 0; // 上电轮速默认0
	  g_car_state = CAR_STATE_RUN; // 测试使用正常删除
		Navigation_SetBadgeEnable(0U); // 雷达避障开启
		float data[4] = {9998.0f,9998.0f,9998.0f,9998.0f};		//上电信号
		VisionUart9_Send4(data,4);
		MechanicalHand_GripperOpen(500);
    while (1)
    {
		 
        // Lidar_Debug_Print_Detail();
        // Navigation_Debug_Print();
        // RobotControl_MainLoopTask(); // 主循环慢任务：雷达解析、视觉处理、夹爪请求执行
        // 按键状态跟新
        //==================
        RobotControl_MainLoopTask(); // 主循环慢任务：雷达解析、视觉处理、夹爪请求执行
			  //Lidar_Debug_Print_Detail();
        //===================
        Key_Scan();
        if (Key_Get_Event(&event))
        {
            Menu_Key_Process(event);
        }
        // 界面绘制
        Menu_Draw();
    }

    /* Wake up 2nd core if this is first core and we are inside a multicore project. */
#if (0 == _RA_CORE) && (1 == BSP_MULTICORE_PROJECT) && !BSP_TZ_NONSECURE_BUILD

#if BSP_TZ_SECURE_BUILD
    /* Take semaphore so 2nd core can clear it */
    R_BSP_IpcSemaphoreTake(&g_core_start_semaphore);
#endif

    R_BSP_SecondaryCoreStart();

#if BSP_TZ_SECURE_BUILD
    /* Wait for 2nd core to start and clear semaphore */
    while (FSP_ERR_IN_USE == R_BSP_IpcSemaphoreTake(&g_core_start_semaphore))
    {
        ;
    }
#endif
#endif

#if (1 == _RA_CORE) && (1 == BSP_MULTICORE_PROJECT) && BSP_TZ_SECURE_BUILD
    /* Signal to 1st core that 2nd core has started */
    R_BSP_IpcSemaphoreGive(&g_core_start_semaphore);
#endif

#if BSP_TZ_SECURE_BUILD
    /* Enter non-secure code */
    R_BSP_NonSecureEnter();
#endif
}

#if BSP_TZ_SECURE_BUILD

FSP_CPP_HEADER
BSP_CMSE_NONSECURE_ENTRY void template_nonsecure_callable();

/* Trustzone Secure Projects require at least one nonsecure callable function in order to build (Remove this if it is not required to build). */
BSP_CMSE_NONSECURE_ENTRY void template_nonsecure_callable()
{
}
FSP_CPP_FOOTER

#endif
